## boards/arm/nrf_esc_supermini/Kconfig.board
```kconfig
# Copyright (c) 2024 Nordic Semiconductor ASA
# SPDX-License-Identifier: Apache-2.0

config BOARD_NRF_ESC_SUPERMINI
	bool "nrf-esc-supermini"
	select SOC_DCDC_NRF52X
	depends on SOC_NRF52840_QIAA
```

## boards/arm/nrf_esc_supermini/Kconfig.defconfig
```kconfig
# Copyright (c) 2024 Nordic Semiconductor ASA
# SPDX-License-Identifier: Apache-2.0

if BOARD_NRF_ESC_SUPERMINI

config BOARD
	default "nrf-esc-supermini"

config BT_CTLR
   default BT


endif
```
